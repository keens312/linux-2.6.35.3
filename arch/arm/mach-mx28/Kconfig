## arch/arm/mach-mx28/Kconfig
```kconfig
choice
	prompt "Select i.MXS board type"

config MACH_MX28EVK
	bool "Freescale MX28 EVK board"
	depends on ARCH_MX28
	select USB_ARCH_HAS_EHCI

endchoice

choice
	prompt "Select M28x platform"

config EPC_28xA
	bool "enable EPC-28xA"
	depends on ARCH_MX28
	select USB_ARCH_HAS_EHCI

config EPC_283B
	bool "enable EPC-283B"
	depends on ARCH_MX28
	select USB_ARCH_HAS_EHCI
	
config EPC_287B
	bool "enable EPC-287B"
	depends on ARCH_MX28
	select USB_ARCH_HAS_EHCI
	
config EPC_280
	bool "enable EPC-280"
	depends on ARCH_MX28
	select USB_ARCH_HAS_EHCI

config IoT_3960
	bool "enable IoT-3960"
	depends on ARCH_MX28
	select USB_ARCH_HAS_EHCI
	
config IoT_3962
	bool "enable IoT-3962"
	depends on ARCH_MX28
	select USB_ARCH_HAS_EHCI
	
config A287_W128LI
	bool "enable A287-W128LI"
	depends on ARCH_MX28
	select USB_ARCH_HAS_EHCI
	
config A287_WB128LI
	bool "enable A287-WB128LI"
	depends on ARCH_MX28
	select USB_ARCH_HAS_EHCI

endchoice

config CONVERT_TO_SCR_MMC
	bool "Convert to source for mmc module."
	default y
    help
         this file locate drivers/mmc/host/mxs-mmc.c

config CONVERT_TO_SCR_IIC
	bool "Convert to source for IIC module."
	default y
    help
         this dir locate drivers/i2c

config CONVERT_TO_SCR_FEC                                                                                                      
    bool "Convert to source for fec(net) module."
    default y
    help
         this file locate drivers/net/fec.c /drivers/net/fec_switch.c

config CONVERT_TO_SCR_CAN                                                                                                              
    bool "Convert to source for can module."
    default y
    help
         this file locate drivers/net/can/flexcan/drv.c

config CONVERT_TO_SCR_NANDFLASH                                                                                                                   
    bool "Convert to source for nandflash module."
    default y
    help
         this file locate drivers/mtd/nand/gpmi-nfc/gpmi-nfc-main.c

config VECTORS_PHY_ADDR
	int "vectors address"
	default 0
	help
	  This config set vectors table is located which physical address

config MXS_TIMER_WITH_MACH
	bool "System Timer support Compare Match interrupt"
	default y

config MEM_mDDR
	bool "Memory type is mDDR"
	depends on ARCH_MX28
	help
	  Say Y to select mDDR memory
	  
config SDIO2PDEV
	bool "Init sdio2pdev "
	depends on !(SPI2PDEV)
	help
	  Say Y to select sdio2pdev

config SPI2PDEV
	bool "Init spi2pdev "
	depends on ARCH_MX28
	help
	  Say Y to select spi2pdev
	  
config USB_POWER_PIN
	bool "Power enable pin"
	depends on ARCH_MX28
	help
	  Say Y to select USB_POWER_PIN
	  
```

## drivers/usb/serial/gobiserial/Kconfig
```kconfig
config USB_GOBISERIAL
	tristate "SIMCOM Modem USB Serial driver"
	depends on IoT_3960 || IoT_3962
	default y
	help
	  usb serial driver for SIMCOM modem
```

## drivers/video/mxs/Kconfig
```kconfig
config FB_MXS
	tristate "MXS Framebuffer driver"
	depends on FB && ARCH_MXS
	select FB_CFB_FILLRECT
	select FB_CFB_COPYAREA
	select FB_CFB_IMAGEBLIT
	default y
	---help---
	  Say Y here to enable support for the framebuffer driver for the
	  Freescale MXS Board.

choice
	prompt "Select i.MXS PANEL LCD VGA LVDS"
config TM043NDH02
	bool "TM043NDH02"
	depends on FB_MXS
config THW480272F
	bool "TMW480272F"
	depends on FB_MXS
	default y
config TM070RDH13
    bool "TM070RDH13"
	depends on FB_MXS
config TM070RDH12
    bool "TM070RDH12"
	depends on FB_MXS
config LCD_APTFT70_SERIALS
	bool "LCD(800x480) PANEL Compatible with AP-TFT-7.0(7')"
	depends on FB_MXS
endchoice


config FB_MXS_LCD_LMS430
	depends on FB_MXS
	bool "LMS430"
	default y if ARCH_MX23
	---help---
	  Use LMS430 dotclock LCD panel for MXS

config FB_MXS_TVENC
	depends on ARCH_MXS
	bool "TVENC"
	---help---
	  Use TVOUT encoder for MXS
```
